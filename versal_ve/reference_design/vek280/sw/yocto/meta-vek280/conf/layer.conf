## versal_ve/reference_design/vek280/sw/yocto/meta-vek280/conf/layer.conf
```bitbake
BBPATH .= ":${LAYERDIR}"

BBFILES += "${LAYERDIR}/recipes-*/*/*.bb \
            ${LAYERDIR}/recipes-*/*/*.bbappend"

BBFILE_COLLECTIONS += "meta-vek280"
BBFILE_PATTERN_meta-vek280 = "^${LAYERDIR}/"
BBFILE_PRIORITY_meta-vek280 = "6"

LAYERDEPENDS_meta-vek280 = "core"
LAYERSERIES_COMPAT_meta-vek280 = "scarthgap"
```

## versal_ve/reference_design/vek280/sw/yocto/meta-vek280/wic/vek280-sd.wks
```
part /run/media/mmcblk0p1 --source rootfs --change-directory=boot --fixed-size=512M --fstype=vfat --use-label --label boot --active --align 4
part /                    --source rootfs --exclude-path=boot/   --fstype=ext4 --use-label --label root           --align 4
bootloader --ptable msdos
```
