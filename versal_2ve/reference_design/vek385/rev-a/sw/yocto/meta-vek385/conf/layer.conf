## versal_2ve/reference_design/vek385/rev-a/sw/yocto/meta-vek385/conf/layer.conf
```bitbake
# We have a conf and classes directory, add to BBPATH
BBPATH .= ":${LAYERDIR}"

# We have recipes-* directories, add to BBFILES
BBFILES += "${LAYERDIR}/recipes-*/*/*.bb \
            ${LAYERDIR}/recipes-*/*/*.bbappend"

BBFILE_COLLECTIONS += "meta-vek385"
BBFILE_PATTERN_meta-vek385 = "^${LAYERDIR}/"
BBFILE_PRIORITY_meta-vek385 = "6"

LAYERDEPENDS_meta-vek385 = "core"
LAYERSERIES_COMPAT_meta-vek385 = "scarthgap"
```

## versal_2ve/reference_design/vek385/rev-a/sw/yocto/meta-vitis-ai/conf/layer.conf
```bitbake
# We have a conf and classes directory, add to BBPATH
BBPATH .= ":${LAYERDIR}"

# We have recipes-* directories, add to BBFILES
BBFILES += "${LAYERDIR}/recipes-*/*/*.bb \
            ${LAYERDIR}/recipes-*/*/*.bbappend"

BBFILE_COLLECTIONS += "meta-vitis-ai"
BBFILE_PATTERN_meta-vitis-ai = "^${LAYERDIR}/"
BBFILE_PRIORITY_meta-vitis-ai = "6"

LAYERDEPENDS_meta-vitis-ai = "core"
LAYERSERIES_COMPAT_meta-vitis-ai = "scarthgap"
```
